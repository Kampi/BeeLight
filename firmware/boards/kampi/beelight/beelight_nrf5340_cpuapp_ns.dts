/*
 * Copyright (c) 2025 Daniel Kampert
 *
 * SPDX-License-Identifier: Apache-2.0
 */

/dts-v1/;
#include <nordic/nrf5340_cpuappns_qkaa.dtsi>
#include "nrf5340_cpuapp_common.dtsi"

/ {
    model = "BeeLight NRF5340 Application";
    compatible = "nordic,beelight-nrf5340-cpuapp";

    chosen {
        zephyr,sram = &sram0_ns_app;
        zephyr,flash = &flash0;
        zephyr,code-partition = &slot0_ns_partition;
    };
};
