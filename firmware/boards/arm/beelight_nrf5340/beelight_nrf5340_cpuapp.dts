/*
 * Copyright (c) 2025 Daniel Kampert
 *
 * SPDX-License-Identifier: Apache-2.0
 */

/dts-v1/;
#include <nordic/nrf5340_cpuapp_qkaa.dtsi>

#include "beelight_cpuapp_common.dtsi"

/ {
    chosen {
        zephyr,sram = &sram0_image;
        zephyr,flash = &flash0;
        zephyr,code-partition = &slot0_partition;
        zephyr,sram-secure-partition = &sram0_s;
        zephyr,sram-non-secure-partition = &sram0_ns;
    };
};
