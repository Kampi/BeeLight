## firmware/app/boards/kampi/beelight/Kconfig.beelight
```kconfig
config BOARD_BEELIGHT
    select SOC_NRF54L15_CPUAPP if BOARD_BEELIGHT_NRF54L15_CPUAPP || BOARD_BEELIGHT_NRF54L15_CPUAPP_NS
```

## firmware/app/boards/kampi/beelight/beelight_nrf54l15_cpuapp_1_defconfig
```kconfig
CONFIG_SENSOR=y

CONFIG_ADC=y

# Use bitbanging I2C because the hardware I2C pins doesn´t work in this version
CONFIG_I2C_GPIO=y

# Light sensor configuration
CONFIG_APDS9306=y

# BME688 configuration
CONFIG_BME680=n
CONFIG_BME68X_IAQ=y
CONFIG_BME68X_IAQ_SAMPLE_RATE_QUICK_ULTRA_LOW_POWER=y
```

## firmware/app/boards/kampi/beelight/beelight_nrf54l15_cpuapp_2_defconfig
```kconfig
CONFIG_SENSOR=y

CONFIG_ADC=y

CONFIG_I2C=y

# Light sensor configuration
CONFIG_APDS9306=y

# BME688 configuration
CONFIG_BME680=n
CONFIG_BME68X_IAQ=y
CONFIG_BME68X_IAQ_SAMPLE_RATE_QUICK_ULTRA_LOW_POWER=y
```

## firmware/app/boards/kampi/beelight/beelight_nrf54l15_cpuapp_defconfig
```kconfig
CONFIG_FPU=y

CONFIG_NEWLIB_LIBC=y

# Disable UART driver
CONFIG_SERIAL=n

# Disable console
CONFIG_CONSOLE=n

# Enable GPIO
CONFIG_GPIO=y

# Enable MPU
CONFIG_ARM_MPU=y

# Enable the sensing subsystem
CONFIG_SENSOR=y

# Enable the ADC subsystem
CONFIG_ADC=y

# Enable hardware stack protection
CONFIG_HW_STACK_PROTECTION=y

# MPU-based null-pointer dereferencing detection cannot
# be applied as the (0x0 - 0x400) is unmapped for this target.
CONFIG_NULL_POINTER_EXCEPTION_DETECTION_NONE=y

# Enable Cache
CONFIG_CACHE_MANAGEMENT=y
CONFIG_EXTERNAL_CACHE=y

# Start SYSCOUNTER on driver init
CONFIG_NRF_GRTC_START_SYSCOUNTER=y

# ZBUS configuration
CONFIG_ZBUS=y
CONFIG_ZBUS_RUNTIME_OBSERVERS=y
CONFIG_ZBUS_CHANNEL_NAME=y
CONFIG_ZBUS_OBSERVER_NAME=y
CONFIG_ZBUS_CHANNELS_SYS_INIT_PRIORITY=2

CONFIG_HEAP_MEM_POOL_SIZE=1024
CONFIG_SYSTEM_WORKQUEUE_STACK_SIZE=4096

# Settings - Used to store real-time device configuration to flash
CONFIG_SETTINGS=y
CONFIG_SETTINGS_FCB=y
CONFIG_FCB=y
CONFIG_FLASH=y
CONFIG_FLASH_PAGE_LAYOUT=y
CONFIG_FLASH_MAP=y
CONFIG_STREAM_FLASH=y
CONFIG_MPU_ALLOW_FLASH_WRITE=y

# Enable DK LED and Buttons library (used by Zigbee utils)
CONFIG_DK_LIBRARY=y

# Enable the Power Management API
CONFIG_PM_DEVICE=y
CONFIG_PM_DEVICE_RUNTIME=y

# Networking
CONFIG_NET_IPV6=n
CONFIG_NET_IP_ADDR_CHECK=n
CONFIG_NET_UDP=n

# Configure Zigbee
CONFIG_ZIGBEE_ADD_ON=y
CONFIG_ZIGBEE_APP_UTILS=y
CONFIG_ZIGBEE_ROLE_END_DEVICE=y
CONFIG_ZIGBEE_CHANNEL_SELECTION_MODE_SINGLE=y
CONFIG_ZIGBEE_CHANNEL=16

# Must be set to "y" because no external 32 kHz crystal is used here
CONFIG_CLOCK_CONTROL_NRF_K32SRC_RC=y

# Enable API for powering down unused RAM parts
CONFIG_RAM_POWER_DOWN_LIBRARY=y

CONFIG_NCS_APPLICATION_BOOT_BANNER_STRING="BeeLight"
```

## firmware/app/boards/kampi/beelight/beelight_nrf54l15_cpuapp_ns_defconfig
```kconfig
CONFIG_FPU=y

CONFIG_NEWLIB_LIBC=y

# Disable UART driver
CONFIG_SERIAL=n

# Disable console
CONFIG_CONSOLE=n

# Enable GPIO
CONFIG_GPIO=y

# Enable MPU
CONFIG_ARM_MPU=y

# Enable the sensing subsystem
CONFIG_SENSOR=y

# Enable the ADC subsystem
CONFIG_ADC=y

# Enable hardware stack protection
CONFIG_HW_STACK_PROTECTION=y

# MPU-based null-pointer dereferencing detection cannot
# be applied as the (0x0 - 0x400) is unmapped for this target.
CONFIG_NULL_POINTER_EXCEPTION_DETECTION_NONE=y

# Enable TrustZone-M
CONFIG_ARM_TRUSTZONE_M=y

# This Board implies building Non-Secure firmware
CONFIG_TRUSTED_EXECUTION_NONSECURE=y

# Don't enable the cache in the non-secure image as it is a
# secure-only peripheral on 54l
CONFIG_CACHE_MANAGEMENT=n
CONFIG_EXTERNAL_CACHE=n

# Start SYSCOUNTER on driver init
CONFIG_NRF_GRTC_START_SYSCOUNTER=y

# ZBUS configuration
CONFIG_ZBUS=y
CONFIG_ZBUS_RUNTIME_OBSERVERS=y
CONFIG_ZBUS_CHANNEL_NAME=y
CONFIG_ZBUS_OBSERVER_NAME=y
CONFIG_ZBUS_CHANNELS_SYS_INIT_PRIORITY=2

CONFIG_HEAP_MEM_POOL_SIZE=1024
CONFIG_SYSTEM_WORKQUEUE_STACK_SIZE=4096

# Settings - Used to store real-time device configuration to flash
CONFIG_SETTINGS=y
CONFIG_SETTINGS_FCB=y
CONFIG_FCB=y
CONFIG_FLASH=y
CONFIG_FLASH_PAGE_LAYOUT=y
CONFIG_FLASH_MAP=y
CONFIG_STREAM_FLASH=y
CONFIG_MPU_ALLOW_FLASH_WRITE=y

# Enable DK LED and Buttons library (used by ZigBee utils)
CONFIG_DK_LIBRARY=y

# Enable the Power Management API
CONFIG_PM_DEVICE=y
CONFIG_PM_DEVICE_RUNTIME=y

# Networking
CONFIG_NET_IPV6=n
CONFIG_NET_IP_ADDR_CHECK=n
CONFIG_NET_UDP=n

# Configure ZigBee
CONFIG_ZIGBEE_ADD_ON=y
CONFIG_ZIGBEE_APP_UTILS=y
CONFIG_ZIGBEE_ROLE_END_DEVICE=y
CONFIG_ZIGBEE_CHANNEL_SELECTION_MODE_SINGLE=y
CONFIG_ZIGBEE_CHANNEL=16

# Must be set to "y" because no external 32 kHz crystal is used here
CONFIG_CLOCK_CONTROL_NRF_K32SRC_RC=y

# Enable API for powering down unused RAM parts
CONFIG_RAM_POWER_DOWN_LIBRARY=y

CONFIG_NCS_APPLICATION_BOOT_BANNER_STRING="BeeLight"
```

## firmware/app/boards/kampi/beelight/board.yml
```yaml
board:
  name: beelight
  full_name: BeeLight
  vendor: kampi
  revision:
    format: number
    default: "1"
    revisions:
    - name: "0"
    - name: "1"
  socs:
  - name: nrf54l15
    variants:
    - name: ns
      cpucluster: cpuapp
```

## firmware/beelight/app/west.yml
```yaml
manifest:
  remotes:
    - name: ncs
      url-base: https://github.com/nrfconnect

  projects:
    - name: nrf
      remote: ncs
      repo-path: sdk-nrf
      revision: v3.0.0
      import: true

    - name: ncs-zigbee
      remote: ncs
      repo-path: ncs-zigbee
      revision: main
      import: true
```

## firmware/beelight/boards/kampi/beelight/Kconfig.beelight
```kconfig
config BOARD_BEELIGHT
    select SOC_NRF54L05_CPUAPP if BOARD_BEELIGHT_NRF54L05_CPUAPP
    select SOC_NRF54L10_CPUAPP if BOARD_BEELIGHT_NRF54L10_CPUAPP
    select SOC_NRF54L15_CPUAPP if BOARD_BEELIGHT_NRF54L15_CPUAPP || BOARD_BEELIGHT_NRF54L15_CPUAPP_NS
```

## firmware/beelight/boards/kampi/beelight/beelight_nrf54l15_cpuapp_1_defconfig
```kconfig
CONFIG_SENSOR=y

CONFIG_SETTINGS=y
CONFIG_SETTINGS_CUSTOM=y

# Use bitbanging I2C because the I2C pins doesn´t work
CONFIG_I2C_GPIO=y

# Light sensor configuration
CONFIG_APDS9306=y

# BME688 configuration
CONFIG_BME680=y
#CONFIG_BME68X_IAQ=y
#CONFIG_BME68X_IAQ_SAMPLE_RATE_QUICK_ULTRA_LOW_POWER=y
```

## firmware/beelight/boards/kampi/beelight/beelight_nrf54l15_cpuapp_defconfig
```kconfig
CONFIG_FPU=y

# Disable UART driver
CONFIG_SERIAL=n

# Disable console
CONFIG_CONSOLE=n

# Enable GPIO
CONFIG_GPIO=y

# Enable MPU
CONFIG_ARM_MPU=y

# Enable hardware stack protection
CONFIG_HW_STACK_PROTECTION=y

# MPU-based null-pointer dereferencing detection cannot
# be applied as the (0x0 - 0x400) is unmapped for this target.
CONFIG_NULL_POINTER_EXCEPTION_DETECTION_NONE=y

# Enable Cache
CONFIG_CACHE_MANAGEMENT=y
CONFIG_EXTERNAL_CACHE=y

# Start SYSCOUNTER on driver init
CONFIG_NRF_GRTC_START_SYSCOUNTER=y

# ZBUS configuration
CONFIG_ZBUS=y
CONFIG_ZBUS_RUNTIME_OBSERVERS=y
CONFIG_ZBUS_CHANNEL_NAME=y
CONFIG_ZBUS_OBSERVER_NAME=y
CONFIG_ZBUS_CHANNELS_SYS_INIT_PRIORITY=1

# Enable DK LED and Buttons library (used by Zigbee utils)
CONFIG_DK_LIBRARY=y

# Networking
CONFIG_NET_IPV6=n
CONFIG_NET_IP_ADDR_CHECK=n
CONFIG_NET_UDP=n

# Configure Zigbee
#CONFIG_ZIGBEE_ADD_ON=y
#CONFIG_ZIGBEE_APP_UTILS=y
#CONFIG_ZIGBEE_ROLE_END_DEVICE=y

# Must be set to "y" because no external 32 kHz crystal is used here
CONFIG_CLOCK_CONTROL_NRF_K32SRC_RC=y
```

## firmware/beelight/boards/kampi/beelight/beelight_nrf54l15_cpuapp_ns_defconfig
```kconfig
CONFIG_FPU=y

# Disable UART driver
CONFIG_SERIAL=n

# Disable console
CONFIG_CONSOLE=n

# Enable GPIO
CONFIG_GPIO=y

# Enable MPU
CONFIG_ARM_MPU=y

# Enable hardware stack protection
CONFIG_HW_STACK_PROTECTION=y

# MPU-based null-pointer dereferencing detection cannot
# be applied as the (0x0 - 0x400) is unmapped for this target.
CONFIG_NULL_POINTER_EXCEPTION_DETECTION_NONE=y

# Enable TrustZone-M
CONFIG_ARM_TRUSTZONE_M=y

# This Board implies building Non-Secure firmware
CONFIG_TRUSTED_EXECUTION_NONSECURE=y

# Don't enable the cache in the non-secure image as it is a
# secure-only peripheral on 54l
CONFIG_CACHE_MANAGEMENT=n
CONFIG_EXTERNAL_CACHE=n

# Start SYSCOUNTER on driver init
CONFIG_NRF_GRTC_START_SYSCOUNTER=y

# ZBUS configuration
CONFIG_ZBUS=y
CONFIG_ZBUS_RUNTIME_OBSERVERS=y
CONFIG_ZBUS_CHANNEL_NAME=y
CONFIG_ZBUS_OBSERVER_NAME=y
CONFIG_ZBUS_CHANNELS_SYS_INIT_PRIORITY=1

# Enable DK LED and Buttons library (used by ZigBee utils)
CONFIG_DK_LIBRARY=y

# Networking
CONFIG_NET_IPV6=n
CONFIG_NET_IP_ADDR_CHECK=n
CONFIG_NET_UDP=n

# Configure ZigBee
CONFIG_ZIGBEE_ADD_ON=y
CONFIG_ZIGBEE_APP_UTILS=y
CONFIG_ZIGBEE_ROLE_END_DEVICE=y

# Must be set to "y" because no external 32 kHz crystal is used here
CONFIG_CLOCK_CONTROL_NRF_K32SRC_RC=y
```

## firmware/beelight/west.yml
```yaml
manifest:
  remotes:
    - name: ncs
      url-base: https://github.com/nrfconnect

  projects:
    - name: nrf
      remote: ncs
      repo-path: sdk-nrf
      revision: v3.0.0
      import:
        name-blocklist:
          - ci-tools
          - hal_altera
          - hal_cypress
          - hal_infineon
          - hal_microchip
          - hal_nxp
          - hal_openisa
          - hal_silabs
          - hal_xtensa
          - hal_ti
          - loramac-node
          - net-tools
          - edtt
          - trusted-firmware-m
          - sof
      clone-depth: 1

    - name: ncs-zigbee
      remote: ncs
      repo-path: ncs-zigbee
      revision: main
      import: true
```

## firmware/boards/arm/beelight_nrf5340/Kconfig.board
```kconfig
# BeeLight NRF5340 board configuration

# Copyright (c) 2025 Daniel Kampert
# SPDX-License-Identifier: Apache-2.0

if SOC_NRF5340_CPUAPP_QKAA
	config BOARD_BEELIGHT_NRF5340_CPUAPP
		bool "BeeLight nRF5340 Application MCU"

	config BOARD_BEELIGHT_NRF5340_CPUAPP_NS
		bool "BeeLight nRF5340 Application MCU non-secure"
endif

if SOC_NRF5340_CPUNET_QKAA
	config BOARD_BEELIGHT_NRF5340_CPUNET
		bool "BeeLight nRF5340 Network MCU"

endif
```

## firmware/boards/arm/beelight_nrf5340/beelight_nrf5340_cpuapp_defconfig
```kconfig
# SPDX-License-Identifier: Apache-2.0

CONFIG_SOC_SERIES_NRF53X=y
CONFIG_SOC_NRF5340_CPUAPP_QKAA=y

CONFIG_ARM_MPU=y

CONFIG_HW_STACK_PROTECTION=y

CONFIG_ARM_TRUSTZONE_M=y

CONFIG_GPIO=y

CONFIG_I2C=y

CONFIG_PINCTRL=y
```

## firmware/boards/arm/beelight_nrf5340/beelight_nrf5340_cpuapp_ns_defconfig
```kconfig
# SPDX-License-Identifier: Apache-2.0

CONFIG_ARM_MPU=y

CONFIG_HW_STACK_PROTECTION=y

CONFIG_ARM_TRUSTZONE_M=y

CONFIG_TRUSTED_EXECUTION_NONSECURE=y

CONFIG_GPIO=y
```

## firmware/boards/kampi/beelight/Kconfig
```kconfig
if BOARD_BEELIGHT_NRF5340_CPUAPP || BOARD_BEELIGHT_NRF5340_CPUAPP_NS
	config DOMAIN_CPUNET_BOARD
		string
		default "beelight/nrf5340/cpunet"
		help
			The board which will be used for CPUNET domain when creating a multi
			image application where one or more images should be located on
			another board. For example hci_ipc on the nRF5340_cpunet for
			Bluetooth applications.
endif

config DOMAIN_CPUAPP_BOARD
	string
	default "beelight/nrf5340/cpuapp"
	depends on BOARD_BEELIGHT_NRF5340_CPUNET
	help
		The board which will be used for CPUAPP domain when creating a multi
		image application where one or more images should be located on
		another board.
```

## firmware/boards/kampi/beelight/Kconfig.beelight
```kconfig
config BOARD_BEELIGHT
    select SOC_NRF5340_CPUAPP_QKAA if BOARD_BEELIGHT_NRF5340_CPUAPP
    select SOC_NRF5340_CPUAPP_QKAA if BOARD_BEELIGHT_NRF5340_CPUAPP_NS
    select SOC_NRF5340_CPUNET_QKAA if BOARD_BEELIGHT_NRF5340_CPUNET
```

## firmware/boards/kampi/beelight/beelight_nrf5340_cpuapp_1_defconfig
```kconfig
# Light sensor configuration
CONFIG_APDS9306=y
CONFIG_APDS9306_IS_APDS9306_065=y
```

## firmware/boards/kampi/beelight/beelight_nrf5340_cpuapp_ns_defconfig
```kconfig
CONFIG_MAIN_STACK_SIZE=2048
CONFIG_HEAP_MEM_POOL_SIZE=4096
CONFIG_SYSTEM_WORKQUEUE_STACK_SIZE=2048
CONFIG_MAIN_THREAD_PRIORITY=7

CONFIG_ARM_MPU=y

CONFIG_HW_STACK_PROTECTION=y

CONFIG_ARM_TRUSTZONE_M=y

CONFIG_TRUSTED_EXECUTION_NONSECURE=y

CONFIG_GPIO=y

CONFIG_I2C=y

CONFIG_ADC=y

CONFIG_SENSOR=y
```

## firmware/boards/kampi/beelight/board.yml
```yaml
board:
  name: beelight
  vendor: kampi
  revision:
    format: number
    default: "1"
    revisions:
    - name: "1"
  socs:
  - name: "nrf5340"
    variants:
    - name: "ns"
      cpucluster: "cpuapp"
```

## firmware/src/events/Kconfig
```kconfig
module = BEELIGHT_EVENTS
module-str = BEELIGHT_EVENTS
source "subsys/logging/Kconfig.template.log_config"
```

## firmware/src/sensors/Kconfig
```kconfig
module = BEELIGHT_SENSORS
module-str = BEELIGHT_SENSORS
source "subsys/logging/Kconfig.template.log_config"
```
